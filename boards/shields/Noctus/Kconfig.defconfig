## boards/shields/Noctus/Kconfig.defconfig
```kconfig
if SHIELD_ERGOCRESCE_R

config ZMK_KEYBOARD_NAME
    default "Ergocresce_R"

config ZMK_SPLIT
    default y

config ZMK_SPLIT_ROLE_CENTRAL
    default y

endif

if SHIELD_ERGOCRESCE_L

config ZMK_KEYBOARD_NAME
    default "Ergocresce_L"

config ZMK_SPLIT
    default y
    
endif
```

## boards/shields/Noctus/Kconfig.shield
```kconfig
config SHIELD_NERGOCRESCE_R
    def_bool $(shields_list_contains,Ergocresce_R)

config SHIELD_ERGOCRESCE_L
    def_bool $(shields_list_contains,Ergocresce_L)
```
